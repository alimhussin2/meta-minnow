## conf/layer.conf
```bitbake
# We have a conf and classes directory, add to BBPATH
BBPATH .= ":${LAYERDIR}"

# We have recipes-* directories, add to BBFILES
BBFILES += "${LAYERDIR}/recipes-*/*/*.bb \
            ${LAYERDIR}/recipes-*/*/*.bbappend"

BBFILE_COLLECTIONS += "meta-minnow"
BBFILE_PATTERN_meta-minnow = "^${LAYERDIR}/"
BBFILE_PRIORITY_meta-minnow = "6"

LAYERSERIES_COMPAT_meta-minnow = "sumo"
```
